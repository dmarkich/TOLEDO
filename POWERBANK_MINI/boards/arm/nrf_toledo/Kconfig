## POWERBANK_MINI/boards/arm/nrf_toledo/Kconfig
```kconfig
# BL654 DVK board configuration

# Copyright (c) 2019 Laird Connectivity
# SPDX-License-Identifier: Apache-2.0

config BOARD_ENABLE_DCDC
	bool "DCDC mode"
	select SOC_DCDC_NRF52X
	default n
	depends on BOARD_NRF_TOLEDO
```

## POWERBANK_MINI/build/Kconfig/Kconfig.shield
```kconfig
osource "/home/diego/Nordic/ncs/boards/shields/*/Kconfig.shield"
osource "/home/diego/Nordic/ncs/SignatureParfumes/peripheral_uart/boards/shields/*/Kconfig.shield"
osource "/home/diego/Nordic/ncs/nrf/boards/shields/*/Kconfig.shield"
```

## POWERBANK_MINI/build/Kconfig/Kconfig.shield.defconfig
```kconfig
osource "/home/diego/Nordic/ncs/boards/shields/*/Kconfig.defconfig"
osource "/home/diego/Nordic/ncs/SignatureParfumes/peripheral_uart/boards/shields/*/Kconfig.defconfig"
osource "/home/diego/Nordic/ncs/nrf/boards/shields/*/Kconfig.defconfig"
```

## boards/arm/nrf_toledo/Kconfig.board
```kconfig
# BL654 DVK board configuration

# Copyright (c) 2019 Laird Connectivity
# SPDX-License-Identifier: Apache-2.0

config BOARD_NRF_TOLEDO
	bool "NRF_TOLEDO"
	depends on SOC_NRF52840_QIAA
```

## boards/arm/nrf_toledo/Kconfig.defconfig
```kconfig
# BL654 DVK board configuration

# Copyright (c) 2019 Laird Connectivity
# SPDX-License-Identifier: Apache-2.0

if BOARD_NRF_TOLEDO

config BOARD
	default "nrf_toledo"

config BT_CTLR
	default BT

# Enable UART driver, needed for CDC ACM
config SERIAL
	default y

config I2C
	default y


endif # BOARD_NRF_TOLEDO
```
